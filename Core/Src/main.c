/**
  ******************************************************************************
  * @file    /main.c
  * @brief   Main.c is an example of an application layer which uses a port of the C-Motion library to the STM32
  *          Both the C-Motion library and the STM32 libaries are needed.
  * ******************************************************************************
  * @attention
  *
  * Limits of Liability - Under no circumstances shall Performance Motion Devices, Inc. or its affiliates, partners, or suppliers be liable for any indirect
  * incidental, consequential, special or exemplary damages arising out or in connection with the use this example,
  * whether or not the damages were foreseeable and whether or not Performance Motion Devices, Inc. was advised of the possibility of such damages.
  * Determining the suitability of this example is the responsibility of the user and subsequent usage is at their sole risk and discretion.
  * There are no licensing restrictions associated with this example.
  *
  *
  *
  ******************************************************************************
  */

/* Includes ------------------------------------------------------------------*/
#include "main.h"
#include "c-motion.h"
#include "PMDperiph.h"
#include "PMDsys.h"
#include "PMDdiag.h"
#include "PMDutil.h"
#include "PMDdevice.h"


/* Private function prototypes -----------------------------------------------*/
static void MPU_Config(void);
static void SystemClock_Config(void);
static void CPU_CACHE_Enable(void);


PMDresult result; // result value used by PMD_RESULT macro (made global to simplify the example functions)


int main(void)
{

  PMDInterfaceType Interface = InterfaceSerial;
  PMDPeriphHandle hPeriph1,hPeriph2;
  PMDDeviceHandle hDevice;
  PMDDeviceHandle *phDevice = NULL;
  PMDAxisHandle hAxis;
  PMDuint32 vmajor;
  PMDuint32 vminor;
  PMDuint32 version;

  /* Configure the MPU attributes */
  MPU_Config();

  /* Enable the CPU Cache */
  CPU_CACHE_Enable();

  /* STM32H7xx HAL library initialization:
       - Systick timer is configured by default as source of time base, but user 
         can eventually implement his proper time base source (a general purpose 
         timer for example or other time source), keeping in mind that Time base 
         duration should be kept 1ms since PPP_TIMEOUT_VALUEs are defined and 
         handled in milliseconds basis.
       - Set NVIC Group Priority to 4
       - Low Level Initialization
     */
  HAL_Init();

  /* Configure the system clock to 400 MHz */
  SystemClock_Config();
  

     // Beginning of PMD code

      // To do: Select one of the following interfaces to connect to the device
      if (Interface == InterfaceSerial)
      {
          // This is just for reference.  main.h needs modifying if UART6 is not used.
    	  result=PMDPeriphOpenCOM( &hPeriph2, NULL, (int)USART1, 57600, PMDSerialParityNone, PMDSerialStopBits1);

          // USART6 works as is.
          result=PMDPeriphOpenCOM( &hPeriph1, NULL, (int)USART6, 57600, PMDSerialParityNone, PMDSerialStopBits1);
          //PMD_ABORTONERROR(PMDPeriphOpenMultiDrop(&hPeriph, &hPeriph, nodeID)) enable this line if multidrop mode (RS485)
      }
#if(0)   ///not supported yet
      else
      if (Interface == InterfaceTCP)
      {
          PMDprintf("Connecting via TCP\r\n");
          PMD_ABORTONERROR(PMDPeriphOpenTCP( &hPeriph, NULL, PMD_IP4_ADDR(192,168,2,2), 40100, 0 ))
      }
      else
      if (Interface == InterfaceCAN)
      {
          PMDprintf("Connecting via CAN\r\n");
          int baud = PMDCANBaud1000000;
  		int nodeID = 0;
  		PMD_ABORTONERROR(PMDDeviceOpenPeriphCANNodeID(&hPeriph, NULL, baud, nodeID))

      }
      // Open a handle to a PRP (PMD Resource Protocol) device. Also referred as CME (C-Motion Engine)
      PMD_ABORTONERROR(PMDRPDeviceOpen(&hDevice, &hPeriph))
      phDevice = &hDevice;
#endif


      // Open a handle to a PRP (PMD Resource Protocol) device. Also referred as CME (C-Motion Engine)
      // Use this for N-series ION, ION/CME, and Machine Controller.
      PMD_ABORTONERROR(PMDRPDeviceOpen(&hDevice, &hPeriph1))

      //PMD_ABORTONERROR(PMDMPDeviceOpen(&hDevice, &hPeriph1))
      // If communicating to a PMD IC like MC58420, MC58113, MC73118 or an IC DK board use MPDeviceOpen instead of RPDeviceOpen

      phDevice = &hDevice;

      result=PMDDeviceGetVersion(&hDevice, &vmajor, &vminor);
      if(result==0x1002)
      {
    	  result=PMDDeviceGetVersion(&hDevice, &vmajor, &vminor);
      }

      // Motion IC example functions
      PMD_ABORTONERROR(PMDAxisOpen(&hAxis, phDevice, PMDAxis1 ))
      PMD_RESULT(PMDGetVersion32(&hAxis, &version));
      PMDprintf("Magellan version %08X\r\n", (unsigned int) version);

      // To Do:
      // Add any initialization commands like SetupAxis1() generated by Pro-Motion.
      // Then start a move by call ProfileMove()

      PMD_ABORTONERROR(PMDAxisClose(&hAxis));
      PMD_ABORTONERROR(PMDDeviceClose(&hDevice));
      PMD_ABORTONERROR(PMDPeriphClose(&hPeriph1));
      PMD_ABORTONERROR(PMDPeriphClose(&hPeriph2));
      PMDTaskAbort(0);

}



/**
  * @brief  System Clock Configuration
  *         The system Clock is configured as follow : 
  *            System Clock source            = PLL (HSE BYPASS)
  *            SYSCLK(Hz)                     = 400000000 (CPU Clock)
  *            HCLK(Hz)                       = 200000000 (AXI and AHBs Clock)
  *            AHB Prescaler                  = 2
  *            D1 APB3 Prescaler              = 2 (APB3 Clock  100MHz)
  *            D2 APB1 Prescaler              = 2 (APB1 Clock  100MHz)
  *            D2 APB2 Prescaler              = 2 (APB2 Clock  100MHz)
  *            D3 APB4 Prescaler              = 2 (APB4 Clock  100MHz)
  *            HSE Frequency(Hz)              = 8000000
  *            PLL_M                          = 4
  *            PLL_N                          = 400
  *            PLL_P                          = 2
  *            PLL_Q                          = 4
  *            PLL_R                          = 2
  *            VDD(V)                         = 3.3
  *            Flash Latency(WS)              = 4
  * @param  None
  * @retval None
  */
static void SystemClock_Config(void)
{
  RCC_ClkInitTypeDef RCC_ClkInitStruct;
  RCC_OscInitTypeDef RCC_OscInitStruct;
  HAL_StatusTypeDef ret = HAL_OK;
  
  /*!< Supply configuration update enable */
  HAL_PWREx_ConfigSupply(PWR_LDO_SUPPLY);

  /* The voltage scaling allows optimizing the power consumption when the device is
     clocked below the maximum system frequency, to update the voltage scaling value
     regarding system frequency refer to product datasheet.  */
  __HAL_PWR_VOLTAGESCALING_CONFIG(PWR_REGULATOR_VOLTAGE_SCALE1);

  while(!__HAL_PWR_GET_FLAG(PWR_FLAG_VOSRDY)) {}
  
  /* Enable HSE Oscillator and activate PLL with HSE as source */
  RCC_OscInitStruct.OscillatorType = RCC_OSCILLATORTYPE_HSE;
  RCC_OscInitStruct.HSEState = RCC_HSE_BYPASS;
  RCC_OscInitStruct.HSIState = RCC_HSI_OFF;
  RCC_OscInitStruct.CSIState = RCC_CSI_OFF;
  RCC_OscInitStruct.PLL.PLLState = RCC_PLL_ON;
  RCC_OscInitStruct.PLL.PLLSource = RCC_PLLSOURCE_HSE;

  RCC_OscInitStruct.PLL.PLLM = 4;
  RCC_OscInitStruct.PLL.PLLN = 400;
  RCC_OscInitStruct.PLL.PLLFRACN = 0;
  RCC_OscInitStruct.PLL.PLLP = 2;
  RCC_OscInitStruct.PLL.PLLR = 2;
  RCC_OscInitStruct.PLL.PLLQ = 4;

  RCC_OscInitStruct.PLL.PLLVCOSEL = RCC_PLL1VCOWIDE;
  RCC_OscInitStruct.PLL.PLLRGE = RCC_PLL1VCIRANGE_1;
  ret = HAL_RCC_OscConfig(&RCC_OscInitStruct);
  if(ret != HAL_OK)
  {
    Error_Handler();
  }
  
/* Select PLL as system clock source and configure  bus clocks dividers */
  RCC_ClkInitStruct.ClockType = (RCC_CLOCKTYPE_SYSCLK | RCC_CLOCKTYPE_HCLK | RCC_CLOCKTYPE_D1PCLK1 | RCC_CLOCKTYPE_PCLK1 | \
                                 RCC_CLOCKTYPE_PCLK2  | RCC_CLOCKTYPE_D3PCLK1);

  RCC_ClkInitStruct.SYSCLKSource = RCC_SYSCLKSOURCE_PLLCLK;
  RCC_ClkInitStruct.SYSCLKDivider = RCC_SYSCLK_DIV1;
  RCC_ClkInitStruct.AHBCLKDivider = RCC_HCLK_DIV2;
  RCC_ClkInitStruct.APB3CLKDivider = RCC_APB3_DIV2;  
  RCC_ClkInitStruct.APB1CLKDivider = RCC_APB1_DIV2; 
  RCC_ClkInitStruct.APB2CLKDivider = RCC_APB2_DIV2; 
  RCC_ClkInitStruct.APB4CLKDivider = RCC_APB4_DIV2; 
  ret = HAL_RCC_ClockConfig(&RCC_ClkInitStruct, FLASH_LATENCY_4);
  if(ret != HAL_OK)
  {
    Error_Handler();
  }

}
/**
  * @brief  UART error callbacks
  * @param  UartHandle: UART handle
  * @note   This example shows a simple way to report transfer error, and you can
  *         add your own implementation.
  * @retval None
  */
void HAL_UART_ErrorCallback(UART_HandleTypeDef *UartHandle)
{
  Error_Handler();
}


/**
  * @brief EXTI line detection callbacks
  * @param GPIO_Pin: Specifies the pins connected EXTI line
  * @retval None
  */
void HAL_GPIO_EXTI_Callback(uint16_t GPIO_Pin)
{
 // if(GPIO_Pin == BUTTON_USER_PIN)
 // {
 //   UserButtonStatus = 1;
 // }
}



/**
  * @brief  Configure the MPU attributes
  * @param  None
  * @retval None
  */
static void MPU_Config(void)
{
  MPU_Region_InitTypeDef MPU_InitStruct;

  /* Disable the MPU */
  HAL_MPU_Disable();

  /* Configure the MPU as Strongly ordered for not defined regions */
  MPU_InitStruct.Enable = MPU_REGION_ENABLE;
  MPU_InitStruct.BaseAddress = 0x00;
  MPU_InitStruct.Size = MPU_REGION_SIZE_4GB;
  MPU_InitStruct.AccessPermission = MPU_REGION_NO_ACCESS;
  MPU_InitStruct.IsBufferable = MPU_ACCESS_NOT_BUFFERABLE;
  MPU_InitStruct.IsCacheable = MPU_ACCESS_NOT_CACHEABLE;
  MPU_InitStruct.IsShareable = MPU_ACCESS_SHAREABLE;
  MPU_InitStruct.Number = MPU_REGION_NUMBER0;
  MPU_InitStruct.TypeExtField = MPU_TEX_LEVEL0;
  MPU_InitStruct.SubRegionDisable = 0x87;
  MPU_InitStruct.DisableExec = MPU_INSTRUCTION_ACCESS_DISABLE;

  HAL_MPU_ConfigRegion(&MPU_InitStruct);

  /* Enable the MPU */
  HAL_MPU_Enable(MPU_PRIVILEGED_DEFAULT);
}

static void Error_Handler(void)
{
  PMDTaskAbort(0);
}


#ifdef  USE_FULL_ASSERT

/**
  * @brief  Reports the name of the source file and the source line number
  *         where the assert_param error has occurred.
  * @param  file: pointer to the source file name
  * @param  line: assert_param error line source number
  * @retval None
  */
void assert_failed(uint8_t* file, uint32_t line)
{ 
  /* User can add his own implementation to report the file name and line number,
     ex: printf("Wrong parameters value: file %s on line %d\r\n", file, line) */

  /* Infinite loop */
  while (1)
  {
  }
}
#endif

/**
  * @brief  CPU L1-Cache enable.
  * @param  None
  * @retval None
  */
static void CPU_CACHE_Enable(void)
{
  /* Enable I-Cache */
  SCB_EnableICache();

  /* Enable D-Cache */
  SCB_EnableDCache();
}

/**
  * @}
  */

/**
  * @}
  */

